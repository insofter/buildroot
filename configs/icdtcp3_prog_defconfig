## configs/icdtcp3_prog_defconfig
```kconfig
BR2_arm=y
BR2_arm920t=y
BR2_JLEVEL=5
BR2_GCC_VERSION_4_5_X=y
BR2_TOOLCHAIN_BUILDROOT_CXX=y
BR2_TARGET_GENERIC_HOSTNAME="icdtcp3-prog"
BR2_TARGET_GENERIC_ISSUE="Welcome to icdtcp3 factory programmer"
BR2_ROOTFS_DEVICE_CREATION_DYNAMIC_DEVTMPFS=y
BR2_ROOTFS_DEVICE_TABLE="target/generic/device_table-icdtcp3.txt"
BR2_ROOTFS_SKELETON_CUSTOM=y
BR2_ROOTFS_SKELETON_CUSTOM_PATH="fs/skeleton-icdtcp3-prog"
BR2_PACKAGE_BUSYBOX_SHOW_OTHERS=y
BR2_PACKAGE_MTD=y
# BR2_PACKAGE_MTD_FLASHCP is not set
# BR2_PACKAGE_MTD_FLASH_ERASE is not set
# BR2_PACKAGE_MTD_FLASH_ERASEALL is not set
# BR2_PACKAGE_MTD_FLASH_INFO is not set
# BR2_PACKAGE_MTD_FLASH_LOCK is not set
# BR2_PACKAGE_MTD_FLASH_UNLOCK is not set
# BR2_PACKAGE_MTD_MTD_DEBUG is not set
# BR2_PACKAGE_MTD_NANDDUMP is not set
# BR2_PACKAGE_MTD_NANDTEST is not set
# BR2_PACKAGE_MTD_NANDWRITE is not set
# BR2_PACKAGE_MTD_MTDINFO is not set
# BR2_PACKAGE_MTD_UBICRC32 is not set
# BR2_PACKAGE_MTD_UBIDETACH is not set
# BR2_PACKAGE_MTD_UBIFORMAT is not set
# BR2_PACKAGE_MTD_UBIMKVOL is not set
# BR2_PACKAGE_MTD_UBINIZE is not set
# BR2_PACKAGE_MTD_UBIRMVOL is not set
# BR2_PACKAGE_MTD_UBIRSVOL is not set
BR2_PACKAGE_LIBCURL=y
BR2_PACKAGE_CURL=y
# BR2_TARGET_ROOTFS_TAR is not set
BR2_TARGET_ROOTFS_INITRAMFS=y
BR2_LINUX_KERNEL=y
BR2_LINUX_KERNEL_CUSTOM_GIT=y
BR2_LINUX_KERNEL_CUSTOM_GIT_REPO_URL="$(ICDTCP3_GIT_ROOT)/linux"
BR2_LINUX_KERNEL_CUSTOM_GIT_VERSION="v3.1.4-icdtcp3-0.2-2-g07c1851"
BR2_LINUX_KERNEL_DEFCONFIG="icdtcp3"
```

## defconfig
```kconfig
BR2_arm=y
BR2_arm920t=y
BR2_HOST_DIR="$(TOPDIR)/host"
BR2_JLEVEL=5
BR2_TARGET_GENERIC_HOSTNAME="icdtcp3"
BR2_TARGET_GENERIC_ISSUE="Welcome to icdtcp3"
BR2_ROOTFS_DEVICE_CREATION_DYNAMIC_DEVTMPFS=y
BR2_ROOTFS_DEVICE_TABLE="target/generic/device_table-icdtcp3.txt"
BR2_ROOTFS_SKELETON_CUSTOM=y
BR2_ROOTFS_SKELETON_CUSTOM_PATH="fs/skeleton-icdtcp3"
BR2_ROOTFS_POST_BUILD_SCRIPT="support/scripts/icdtcp3-finalize.sh"
BR2_PACKAGE_BUSYBOX_SHOW_OTHERS=y
BR2_PACKAGE_MTD=y
BR2_PACKAGE_PHP=y
BR2_PACKAGE_PHP_EXT_JSON=y
BR2_PACKAGE_PHP_EXT_PDO=y
BR2_PACKAGE_PHP_EXT_PDO_SQLITE=y
BR2_PACKAGE_PHP_EXT_PDO_SQLITE_EXTERNAL=y
BR2_PACKAGE_SQLITE_READLINE=y
BR2_PACKAGE_CURL=y
BR2_PACKAGE_ICD=y
BR2_ICD_CUSTOM_GIT_REPO_URL="$(ICDTCP3_GIT_ROOT)/icd"
BR2_ICD_CUSTOM_GIT_VERSION="v0.1-11-g4689d55"
BR2_PACKAGE_LIGHTTPD=y
BR2_PACKAGE_LIGHTTPD_OPENSSL=y
BR2_PACKAGE_OPENSSH=y
BR2_PACKAGE_RSYNC=y
BR2_PACKAGE_WIRELESS_TOOLS=y
BR2_PACKAGE_WIRELESS_TOOLS_LIB=y
BR2_PACKAGE_WPA_SUPPLICANT=y
BR2_PACKAGE_WPA_SUPPLICANT_EAP=y
BR2_PACKAGE_WPA_SUPPLICANT_CLI=y
BR2_PACKAGE_WPA_SUPPLICANT_PASSPHRASE=y
BR2_PACKAGE_SUDO=y
BR2_PACKAGE_NANO=y
BR2_PACKAGE_VIM=y
BR2_TARGET_ROOTFS_UBIFS=y
BR2_TARGET_ROOTFS_UBIFS_LEBSIZE=0x3f000
BR2_TARGET_ROOTFS_UBIFS_MAXLEBCNT=4096
BR2_TARGET_ROOTFS_UBIFS_RT_NONE=y
# BR2_TARGET_ROOTFS_TAR is not set
BR2_TARGET_UBOOT=y
BR2_TARGET_UBOOT_BOARDNAME="icdtcp3"
BR2_TARGET_UBOOT_CUSTOM_GIT=y
BR2_TARGET_UBOOT_CUSTOM_GIT_REPO_URL="$(ICDTCP3_GIT_ROOT)/u-boot"
BR2_TARGET_UBOOT_CUSTOM_GIT_VERSION="v2011.12-icdtcp3-0.1"
BR2_TARGET_AT91BOOTSTRAP=y
BR2_TARGET_AT91BOOTSTRAP_CUSTOM_GIT_REPO_URL="$(ICDTCP3_GIT_ROOT)/at91bootstrap"
BR2_TARGET_AT91BOOTSTRAP_CUSTOM_GIT_VERSION="v1.16-icdtcp3-0.1"
BR2_TARGET_AT91BOOTSTRAP_BOARD="icdtcp3"
BR2_TARGET_AT91BOOTSTRAP_NANDFLASH=y
BR2_LINUX_KERNEL=y
BR2_LINUX_KERNEL_CUSTOM_GIT=y
BR2_LINUX_KERNEL_CUSTOM_GIT_REPO_URL="$(ICDTCP3_GIT_ROOT)/linux"
BR2_LINUX_KERNEL_CUSTOM_GIT_VERSION="v3.1.4-icdtcp3-0.1"
BR2_LINUX_KERNEL_DEFCONFIG="icdtcp3"
```

## package/icd/Config.in
```kconfig
config BR2_PACKAGE_ICD
        bool "icd"
        select BR2_PACKAGE_SQLITE
        select BR2_PACKAGE_LIBCURL
        select BR2_PACKAGE_LIBROXML
        help
          ICD is a software package for counting of moving objects. It works
          with one or more photocell. The passing objects (e.g. people)
          generates input state transitions which are counted, aggregated
          and later sendto a server

          This package also relays on some custom device drivers which are
          expected to be included in the kernel.
       
          http://www.insofter.pl

if BR2_PACKAGE_ICD

config BR2_ICD_CUSTOM_GIT_REPO_URL
        string "URL of Git repository"

config BR2_ICD_CUSTOM_GIT_VERSION
        string "Git version"

endif
```

## package/wvdial/Config.in
```kconfig
config BR2_PACKAGE_WVDIAL
        bool "wvdial"
        select BR2_PACKAGE_WVSTREAMS
        help
          wvdial package
```

## package/wvstreams/Config.in
```kconfig
config BR2_PACKAGE_WVSTREAMS
        bool "wvstreams"
        select BR2_PACKAGE_OPENSSL
        help
          wvstreams package
```
